## conf/layer.conf
```bitbake
# We have a conf and classes directory, add to BBPATH
BBPATH .= ":${LAYERDIR}"

# We have recipes-* directories, add to BBFILES
BBFILES += "${LAYERDIR}/recipes-*/*/*.bb \
            ${LAYERDIR}/recipes-*/*/*.bbappend"

BBFILE_COLLECTIONS += "meta-robotics"
BBFILE_PATTERN_meta-robotics = "^${LAYERDIR}/"
BBFILE_PRIORITY_meta-robotics = "9"

LAYERDEPENDS_meta-robotics = "core"
LAYERSERIES_COMPAT_meta-robotics = "nanbield scarthgap"
```
